/dts-v1/;
/plugin/;

/ {
    compatible = "brcm,bcm2708";

    fragment@0 {
        target = <&gpio>;
        __overlay__ {
            pinctrl-names = "default";
            pinctrl-0 = <&tb2_pins>;

            tb2_pins: tb2_pins {
                brcm,pins = <7 8 9 10>;     /* ToF sensors XSHUT */
                brcm,function = <1 1 1 1>; /* 0:in, 1:out */
                brcm,pull = <0 0 0 0>;     /* 2:up 1:down 0:none */
            };
        };
    };
};
